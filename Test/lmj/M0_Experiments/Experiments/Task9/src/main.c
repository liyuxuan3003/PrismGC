#include"code_def.h"
#include<stdbool.h>
#include<stdint.h>

char Music_1[]   ={ 0x16,0x03,0x21,0x03,0x23,0x03,0x26,0x03,
                    0x31,0x03,0x33,0x03,0x17,0x03,0x22,0x03,
                    0x25,0x03,0x27,0x03,0x12,0x03,0x15,0x03,
                    0x21,0x03,0x23,0x03,0x26,0x03,0x31,0x03,
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                    0x25,0x02,0x27,0x02,0x26,0x00,0x00,0x00 };__attribute__((aligned(2)));

char Music_2[]   ={ 0x00,0x04,0x16,0x04,0x16,0x04,0x26,0x03,
                    0x23,0x03,0x22,0x04,0x00,0x04,0x22,0x03,
                    0x21,0x04,0x21,0x04,0x16,0x04,0x21,0x04,
                    0x22,0x04,0x15,0x04,0x15,0x04,0x26,0x03,
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                    0x00,0x00};__attribute__((aligned(2)));

char Sound[]     ={ 0x32,0x02,0x00,0x00};__attribute__((aligned(2)));

const uint32_t ColTab[352] = {  0,  0,  0,  0,  0,  0,  0,  0,  0,  0,  0,  0,  0,  0,  0,  0,
								0,  0,  0,  0,  0,  0,  0,  0,  0,  0,  0,  1,  7, 37,125,197,
								0,  0,  0,  0,  0,  0,  0,  0,  0,  0,  0,  4, 26, 99,192,151,
								0,  0,  0,  0,  0,  0,  0,  0,  0,  0,  2, 17, 76,178,174, 71,
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								192, 99, 26,  4,  0,  0,  0,  0,  0,  0,  0,  0,  0,  0,  0,  0};
const uint32_t colorTab[16] = {BLACK,BLUE,BRED,GRED,GBLUE,RED,MAGENTA,GREEN,CYAN,YELLOW,BROWN,BRRED,GRAY,BRED,GRED,GBLUE};

bool isPlaying,isStop;
uint32_t Music_num = 0;
int Beat_flag = 0;

extern uint32_t LCD_ini_finish;

char tune = 0;


void drawCol(char colNum,uint32_t* col,uint32_t dest,uint16_t color)
{
	if(*col < dest)
	{
		LCD_Fill(*col,20*colNum,dest,20*colNum+20,color);
		*col = dest;
	}
	else if(*col > dest)
	{
		LCD_Fill(*col-((*col-dest)^2)/5-1,20*colNum,*col,20*colNum+20,WHITE);
		*col = *col-((*col-dest)^2)/5-1;
	}
}

int PlayCol(void)
{
	uint32_t ColPlay[16]={0};
	int i,j;

	while(1)
	{
		if(Beat_flag)
		{
			if(Buzzer->BuzzerBGMCtr & 2)
			{
				unsigned temp = Buzzer->BuzzerTune;
				tune = (temp&0x0000000f) + (((temp&0x000000f0)>>4) - 1)*7;	
			}
			else
			{
				tune = 0;
			}
			Beat_flag = 0;
		}
		for(i=0;i<16;i++)
		{
			if(tune>=0&&tune<22)
			drawCol(i,&ColPlay[i],ColTab[tune*16+i],colorTab[i]);
			j = 12000;
			while(j--);
		}
	}

	return j;

}


int main()
{
	SYSInit();
	isPlaying = false;
	isStop = false;

	uint16_t x, y;
	uint8_t dx, dy;

	LCD->LCD_MODE = 1;
	LCD_RST_CLR;
	LCD_RST_SET;
	LCD_BL_CTR_SET;
	x  = y  = 110;
	dx = dy = 20;
	LCD_Init();
	while(!LCD_ini_finish) ;
	LCD_ini_finish = 0;
	LCD -> LCD_MODE = 1;
	LCD_CS_SET;
	LCD_RS_SET;
	LCD_WR_SET;
	LCD_RD_SET;

	PlayCol();

	return 0;
}

void KEY(void)
{
	uint32_t din;
	din = KeyboardReg;

	if(din & 0x00000008)
	{
		if(isPlaying)
		{
			if(isStop)
			{
				StartBGM();
				isStop = false;
			}
			else
			{
				StopBGM();
				isStop = true;
			}
		}
		else
		{
			PlayBGM(Music_1,true);
			isPlaying = true;
		}
	}
	else if(din & 0x00000080)
	{
		if(Music_num == 1)
		{
			Music_num = 0;
			ResetBGM();
			PlayBGM(Music_1,true);
		}
		else
		{
			Music_num = 1;
			ResetBGM();
			PlayBGM(Music_2,true);
		}
	}

}

void BEAT(void)
{
	NVIC_CTRL_ADDR	=	0x0;
	Beat_flag = 1;
	NVIC_CTRL_ADDR	=	0x7;
}

